## conf/distro/meshiotdist.conf
```bitbake
require conf/distro/poky.conf
# distro name
DISTRO = "meshiotdist"
DISTRO_NAME = "meshiotdist distribution"
DISTRO_VERSION = "1.0"
DISTRO_CODENAME = "koras"
DISTRO_FEATURES_append = " \
    systemd \
    virtualization \
"
MAINTAINER = "Dmytro Chystiakov <dlchistyakov@gmail.com>"
DISTRO_FEATURES_BACKFILL_CONSIDERED += "sysvinit"
VIRTUAL-RUNTIME_init_manager = "systemd"
VIRTUAL-RUNTIME_initscripts = "systemd-compat-units"
SDK_VENDOR = "-meshiotsdk"
SDK_VERSION := "${@'${DISTRO_VERSION}'.replace('snapshot-${DATE}','snapshot')}"
MAINTAINER = "meshiotdist "
INHERIT += "buildhistory"
BUILDHISTORY_COMMIT = "1"
ENABLE_UART = "1"
DISABLE_RPI_BOOT_LOGO = "1"
```

## conf/layer.conf
```bitbake
BBPATH .= ":${LAYERDIR}"

BBFILES += "${LAYERDIR}/recipes-*/*/*.bb \
            ${LAYERDIR}/recipes-*/*/*.bbappend"

BBFILE_COLLECTIONS += "meshiot"
BBFILE_PATTERN_meshiot := "^${LAYERDIR}/"
BBFILE_PRIORITY_meshiot = "1337"
LAYERSERIES_COMPAT_meshiot = "sumo"
```
